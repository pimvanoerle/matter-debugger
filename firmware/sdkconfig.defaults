## firmware/sdkconfig.defaults.esp32c6
```kconfig
# 802.15.4 / Thread, only on chips that have the radio.
CONFIG_OPENTHREAD_ENABLED=y
CONFIG_OPENTHREAD_CLI=n
CONFIG_OPENTHREAD_BORDER_ROUTER=n

CONFIG_MBEDTLS_CMAC_C=y
CONFIG_MBEDTLS_SSL_PROTO_DTLS=y
CONFIG_MBEDTLS_KEY_EXCHANGE_ECJPAKE=y
CONFIG_MBEDTLS_ECJPAKE_C=y

CONFIG_LWIP_IPV6_NUM_ADDRESSES=8
CONFIG_LWIP_MULTICAST_PING=y
CONFIG_LWIP_HOOK_IP6_SELECT_SRC_ADDR_CUSTOM=y
```
